## ZynqBSP/zynqPLNX/project-spec/configs/rootfsconfigs/Kconfig.user
```kconfig
menu "user packages " 
config cmakeCONFIG  
	 bool "cmakeCONFIG"
	 help
	
config gpio-demo  
	 bool "gpio-demo"
	 help
	
config htop  
	 bool "htop"
	 help
	
config peekpoke  
	 bool "peekpoke"
	 help
	
endmenu
```
